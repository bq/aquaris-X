/*
 * Copyright (c) 2015, The Linux Foundation. All rights reserved.
 *
 * This program is free software; you can redistribute it and/or modify
 * it under the terms of the GNU General Public License version 2 and
 * only version 2 as published by the Free Software Foundation.
 *
 * This program is distributed in the hope that it will be useful,
 * but WITHOUT ANY WARRANTY; without even the implied warranty of
 * MERCHANTABILITY or FITNESS FOR A PARTICULAR PURPOSE.  See the
 * GNU General Public License for more details.
 */

/*---------------------------------------------------------------------------
 * This file is autogenerated file using gcdb parser. Please do not edit it.
 * Update input XML file to add a new entry or update variable in this file
 * VERSION = "1.0"
 *---------------------------------------------------------------------------*/
&mdss_mdp {
	dsi_sc_ili9881c_720p_video: qcom,mdss_dsi_sc_ili9881c_720p_video {
		qcom,mdss-dsi-panel-name = "ili9881c djn 720p video mode dsi panel";
		qcom,mdss-dsi-panel-controller = <&mdss_dsi0>;
		qcom,mdss-dsi-panel-type = "dsi_video_mode";
		qcom,mdss-dsi-panel-destination = "display_1";
		qcom,mdss-dsi-panel-framerate = <60>;
		qcom,mdss-dsi-virtual-channel-id = <0>;
		qcom,mdss-dsi-stream = <0>;
		qcom,mdss-dsi-panel-width = <720>;
		qcom,mdss-dsi-panel-height = <1280>;
		qcom,mdss-dsi-h-front-porch = <60>;
		qcom,mdss-dsi-h-back-porch = <60>;
		qcom,mdss-dsi-h-pulse-width = <20>;
		qcom,mdss-dsi-h-sync-skew = <0>;
		qcom,mdss-dsi-v-back-porch = <36>;
		qcom,mdss-dsi-v-front-porch = <36>;
		qcom,mdss-dsi-v-pulse-width = <8>;
		qcom,mdss-dsi-h-left-border = <0>;
		qcom,mdss-dsi-h-right-border = <0>;
		qcom,mdss-dsi-v-top-border = <0>;
		qcom,mdss-dsi-v-bottom-border = <0>;
		qcom,mdss-dsi-bpp = <24>;
		qcom,mdss-dsi-color-order = "rgb_swap_rgb";
		qcom,mdss-dsi-underflow-color = <0xff>;
		qcom,mdss-dsi-border-color = <0>;
                qcom,mdss-pan-physical-width-dimension = <65>;
                qcom,mdss-pan-physical-height-dimension = <115>;
		qcom,mdss-dsi-on-command = [39 01 00 00 00 00   04 FF 98 81 03
		39 01 00 00 00 00	02 01 08
		39 01 00 00 00 00	02 02 00
		39 01 00 00 00 00	02 03 73
		39 01 00 00 00 00	02 04 73
		39 01 00 00 00 00	02 05 14
		39 01 00 00 00 00	02 06 06
		39 01 00 00 00 00	02 07 02
		39 01 00 00 00 00	02 08 05
		39 01 00 00 00 00	02 09 14
		39 01 00 00 00 00	02 0a 14
		39 01 00 00 00 00	02 0b 00
		39 01 00 00 00 00	02 0c 14
		39 01 00 00 00 00	02 0d 14
		39 01 00 00 00 00	02 0e 00
		39 01 00 00 00 00	02 0f 0C
		39 01 00 00 00 00	02 10 0C
		39 01 00 00 00 00	02 11 0C
		39 01 00 00 00 00	02 12 0C
		39 01 00 00 00 00	02 13 14
		39 01 00 00 00 00	02 14 0C
		39 01 00 00 00 00	02 15 00
		39 01 00 00 00 00	02 16 00
		39 01 00 00 00 00	02 17 00
		39 01 00 00 00 00	02 18 00
		39 01 00 00 00 00	02 19 00
		39 01 00 00 00 00	02 1a 00
		39 01 00 00 00 00	02 1b 00
		39 01 00 00 00 00	02 1c 00
		39 01 00 00 00 00	02 1d 00
		39 01 00 00 00 00	02 1e C8
		39 01 00 00 00 00	02 1f 80
		39 01 00 00 00 00	02 20 02
		39 01 00 00 00 00	02 21 00
		39 01 00 00 00 00	02 22 02
		39 01 00 00 00 00	02 23 00
		39 01 00 00 00 00	02 24 00
		39 01 00 00 00 00	02 25 00
		39 01 00 00 00 00	02 26 00
		39 01 00 00 00 00	02 27 00
		39 01 00 00 00 00	02 28 FB
		39 01 00 00 00 00	02 29 43
		39 01 00 00 00 00	02 2a 00
		39 01 00 00 00 00	02 2b 00
		39 01 00 00 00 00	02 2c 07
		39 01 00 00 00 00	02 2d 07
		39 01 00 00 00 00	02 2e FF
		39 01 00 00 00 00	02 2f FF
		39 01 00 00 00 00	02 30 11
		39 01 00 00 00 00	02 31 00
		39 01 00 00 00 00	02 32 00
		39 01 00 00 00 00	02 33 00
		39 01 00 00 00 00	02 34 84
		39 01 00 00 00 00	02 35 80
		39 01 00 00 00 00	02 36 07
		39 01 00 00 00 00	02 37 00
		39 01 00 00 00 00	02 38 00
		39 01 00 00 00 00	02 39 00
		39 01 00 00 00 00	02 3a 00
		39 01 00 00 00 00	02 3b 00
		39 01 00 00 00 00	02 3c 00
		39 01 00 00 00 00	02 3d 00
		39 01 00 00 00 00	02 3e 00
		39 01 00 00 00 00	02 3f 00
		39 01 00 00 00 00	02 40 00
		39 01 00 00 00 00	02 41 88
		39 01 00 00 00 00	02 42 00
		39 01 00 00 00 00	02 43 80
		39 01 00 00 00 00	02 44 08
		39 01 00 00 00 00	02 50 01
		39 01 00 00 00 00	02 51 23
		39 01 00 00 00 00	02 52 45
		39 01 00 00 00 00	02 53 67
		39 01 00 00 00 00	02 54 89
		39 01 00 00 00 00	02 55 ab
		39 01 00 00 00 00	02 56 01
		39 01 00 00 00 00	02 57 23
		39 01 00 00 00 00	02 58 45
		39 01 00 00 00 00	02 59 67
		39 01 00 00 00 00	02 5a 89
		39 01 00 00 00 00	02 5b ab
		39 01 00 00 00 00	02 5c cd
		39 01 00 00 00 00	02 5d ef
		39 01 00 00 00 00	02 5e 10
		39 01 00 00 00 00	02 5f 02
		39 01 00 00 00 00	02 60 08
		39 01 00 00 00 00	02 61 09
		39 01 00 00 00 00	02 62 10
		39 01 00 00 00 00	02 63 12
		39 01 00 00 00 00	02 64 11
		39 01 00 00 00 00	02 65 13
		39 01 00 00 00 00	02 66 0C
		39 01 00 00 00 00	02 67 02
		39 01 00 00 00 00	02 68 02
		39 01 00 00 00 00	02 69 02
		39 01 00 00 00 00	02 6a 02
		39 01 00 00 00 00	02 6b 02
		39 01 00 00 00 00	02 6c 0E
		39 01 00 00 00 00	02 6d 0D
		39 01 00 00 00 00	02 6e 0F
		39 01 00 00 00 00	02 6f 02
		39 01 00 00 00 00	02 70 02
		39 01 00 00 00 00	02 71 06
		39 01 00 00 00 00	02 72 07
		39 01 00 00 00 00	02 73 02
		39 01 00 00 00 00	02 74 02
		39 01 00 00 00 00	02 75 02
		39 01 00 00 00 00	02 76 07
		39 01 00 00 00 00	02 77 06
		39 01 00 00 00 00	02 78 11
		39 01 00 00 00 00	02 79 13
		39 01 00 00 00 00	02 7a 10
		39 01 00 00 00 00	02 7b 12
		39 01 00 00 00 00	02 7c 0F
		39 01 00 00 00 00	02 7d 02 
		39 01 00 00 00 00	02 7e 02
		39 01 00 00 00 00	02 7f 02
		39 01 00 00 00 00	02 80 02
		39 01 00 00 00 00	02 81 02
		39 01 00 00 00 00	02 82 0D
		39 01 00 00 00 00	02 83 0E
		39 01 00 00 00 00	02 84 0C
		39 01 00 00 00 00	02 85 02
		39 01 00 00 00 00	02 86 02
		39 01 00 00 00 00	02 87 09
		39 01 00 00 00 00	02 88 08
		39 01 00 00 00 00	02 89 02
		39 01 00 00 00 00	02 8a 02
		39 01 00 00 00 00   04 FF 98 81 04
		39 01 00 00 00 00	02 6C 15
		39 01 00 00 00 00	02 6E 28                //VGH clamp 15V
		39 01 00 00 00 00	02 6F 35                
		39 01 00 00 00 00	02 3A 24                
		39 01 00 00 00 00	02 8D 1F                //VGL clamp -12V
		39 01 00 00 00 00	02 87 BA               
		39 01 00 00 00 00	02 26 76            
		39 01 00 00 00 00	02 B2 D1
		39 01 00 00 00 00	02 69 57
		39 01 00 00 00 00	02 33 44
		39 01 00 00 00 00	02 88 0B
		39 01 00 00 00 00	02 35 1F
		39 01 00 00 00 00	02 B5 07
		39 01 00 00 00 00   04 FF 98 81 01
		39 01 00 00 00 00	02 22 0A		//BGR, SS
		39 01 00 00 00 00	02 31 00		//column inversion
		39 01 00 00 00 00	02 53 56		//VCOM1 
		39 01 00 00 00 00	02 55 8f		//VCOM2
		39 01 00 00 00 00	02 50 7A          	//VREG1OUT
		39 01 00 00 00 00	02 51 7A        	//VREG2OUT
		39 01 00 00 00 00	02 60 14               //SDT
		39 01 00 00 00 00	02 A0 00 		//VP255	Gamma P
		39 01 00 00 00 00	02 A1 2A               //VP251        
		39 01 00 00 00 00	02 A2 3A               //VP247        
		39 01 00 00 00 00	02 A3 17               //VP243        
		39 01 00 00 00 00	02 A4 18               //VP239        
		39 01 00 00 00 00	02 A5 2C               //VP231        
		39 01 00 00 00 00	02 A6 20               //VP219        
		39 01 00 00 00 00	02 A7 20               //VP203	        
		39 01 00 00 00 00	02 A8 A6               //VP175        
		39 01 00 00 00 00	02 A9 1E               //VP144        
		39 01 00 00 00 00	02 AA 29               //VP111        
		39 01 00 00 00 00	02 AB 8C               //VP80         
		39 01 00 00 00 00	02 AC 1C               //VP52         
		39 01 00 00 00 00	02 AD 1C               //VP36         
		39 01 00 00 00 00	02 AE 50               //VP24         
		39 01 00 00 00 00	02 AF 25               //VP16         
		39 01 00 00 00 00	02 B0 2A               //VP12         
		39 01 00 00 00 00	02 B1 51               //VP8          
		39 01 00 00 00 00	02 B2 5F               //VP4          
		39 01 00 00 00 00	02 B3 3F               //VP0          
		39 01 00 00 00 00	02 C0 06		//VN255 GAMMA N
		39 01 00 00 00 00	02 C1 2A               //VN251        
		39 01 00 00 00 00	02 C2 3A               //VN247        
		39 01 00 00 00 00	02 C3 17               //VN243        
		39 01 00 00 00 00	02 C4 18               //VN239        
		39 01 00 00 00 00	02 C5 2C               //VN231        
		39 01 00 00 00 00	02 C6 20               //VN219        
		39 01 00 00 00 00	02 C7 20               //VN203        
		39 01 00 00 00 00	02 C8 A6               //VN175        
		39 01 00 00 00 00	02 C9 1E               //VN144        
		39 01 00 00 00 00	02 CA 29               //VN111        
		39 01 00 00 00 00	02 CB 8C               //VN80         
		39 01 00 00 00 00	02 CC 1D               //VN52         
		39 01 00 00 00 00	02 CD 1C               //VN36         
		39 01 00 00 00 00	02 CE 50               //VN24         
		39 01 00 00 00 00	02 CF 25               //VN16         
		39 01 00 00 00 00	02 D0 2A               //VN12         
		39 01 00 00 00 00	02 D1 51               //VN8          
		39 01 00 00 00 00	02 D2 5F               //VN4          
		39 01 00 00 00 00	02 D3 3F               //VN0
		39 01 00 00 00 00	04 FF 98 81 00
		39 01 00 00 00 00	02 35 00
		05 01 00 00 78 00   02 11 00 
		05 01 00 00 14 00   02 29 00];
		qcom,mdss-dsi-off-command = [05 01 00 00 0A 00 02 28 00
					05 01 00 00 78 00 02 10 00];
		qcom,mdss-dsi-on-command-state = "dsi_lp_mode";
		qcom,mdss-dsi-off-command-state = "dsi_lp_mode";
		qcom,mdss-dsi-h-sync-pulse = <1>;
		qcom,mdss-dsi-traffic-mode = "burst_mode";
		qcom,mdss-dsi-lane-map = "lane_map_0123";
		qcom,mdss-dsi-bllp-eof-power-mode;
		qcom,mdss-dsi-bllp-power-mode;
		qcom,mdss-dsi-lp11-init;
		qcom,mdss-dsi-lane-0-state;
		qcom,mdss-dsi-lane-1-state;
		qcom,mdss-dsi-lane-2-state;
		qcom,mdss-dsi-lane-3-state;
		qcom,mdss-dsi-panel-timings = [7B 1A 10 00 3E 42 16 1E 15 03 04 00];
		qcom,mdss-dsi-panel-status-command = [06 01 00 01 05 00 02 0A 00];
		qcom,mdss-dsi-panel-status-value = <0x9C>;
		qcom,mdss-dsi-panel-status-command-state = "dsi_lp_mode";
		qcom,mdss-dsi-panel-status-check-mode = "reg_read";
		qcom,mdss-dsi-panel-status-read-length = <1>;
		qcom,mdss-dsi-t-clk-post = <0x04>;
		qcom,mdss-dsi-t-clk-pre = <0x19>;
		qcom,mdss-dsi-bl-min-level = <1>;
		qcom,mdss-dsi-bl-max-level = <255>;
		qcom,mdss-dsi-dma-trigger = "trigger_sw";
		qcom,mdss-dsi-bl-pmic-control-type = "bl_ctrl_pwm";
		qcom,mdss-dsi-bl-pmic-pwm-frequency = <50>;
		qcom,mdss-dsi-bl-pmic-bank-select = <0>;
		qcom,mdss-dsi-pwm-gpio = <&pm8937_mpps 4 0>;
		qcom,mdss-dsi-mdp-trigger = "none";
		qcom,mdss-dsi-reset-sequence = <1 20>, <0 10>, <1 20>;
		qcom,panel-supply-entries = <&dsi_panel_pwr_supply>;
	};
};
