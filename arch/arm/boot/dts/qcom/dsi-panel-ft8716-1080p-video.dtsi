/* Copyright (c) 2013-2015, The Linux Foundation. All rights reserved.
 *
 * This program is free software; you can redistribute it and/or modify
 * it under the terms of the GNU General Public License version 2 and
 * only version 2 as published by the Free Software Foundation.
 *
 * This program is distributed in the hope that it will be useful,
 * but WITHOUT ANY WARRANTY; without even the implied warranty of
 * MERCHANTABILITY or FITNESS FOR A PARTICULAR PURPOSE.  See the
 * GNU General Public License for more details.
 */

&mdss_mdp {
	dsi_ft8716_1080_vid: qcom,mdss_dsi_ft8716_1080p_video {
		qcom,mdss-dsi-panel-name = "ft8716 1080p video mode dsi panel";
		qcom,mdss-dsi-panel-id = <1>;
		qcom,mdss-dsi-panel-type = "dsi_video_mode";
		qcom,mdss-dsi-panel-framerate = <60>;
		qcom,mdss-dsi-virtual-channel-id = <0>;
		qcom,mdss-dsi-stream = <0>;
		qcom,mdss-dsi-panel-width = <1080>;
		qcom,mdss-dsi-panel-height = <1920>;
		qcom,mdss-dsi-h-front-porch = <32>;
		qcom,mdss-dsi-h-back-porch = <32>;
		qcom,mdss-dsi-h-pulse-width = <4>;
		qcom,mdss-dsi-h-sync-skew = <0>;
		qcom,mdss-dsi-v-back-porch = <16>;
		qcom,mdss-dsi-v-front-porch = <16>;
		qcom,mdss-dsi-v-pulse-width = <2>;
		qcom,mdss-dsi-h-left-border = <0>;
		qcom,mdss-dsi-h-right-border = <0>;
		qcom,mdss-dsi-v-top-border = <0>;
		qcom,mdss-dsi-v-bottom-border = <0>;
		qcom,mdss-dsi-bpp = <24>;
		qcom,mdss-dsi-underflow-color = <0xff>;
		qcom,mdss-dsi-border-color = <0>;
                qcom,cont-splash-enabled;
		qcom,mdss-dsi-on-command = [
			29 01 00 00 00 00 02 00 00
			29 01 00 00 00 00 04 FF 87 16 01
			29 01 00 00 00 00 02 00 80
			29 01 00 00 00 00 03 FF 87 16
/*
			29 01 00 00 00 00 02 00 A2
			29 01 00 00 00 00 02 C1 30  //disable timeout function
*/
			29 01 00 00 00 00 02 00 00
			29 01 00 00 00 00 04 FF 00 00 00
			29 01 00 00 00 00 02 00 80
			29 01 00 00 00 00 03 FF 00 00  //CMD 2 disable
			29 01 00 00 00 00 02 35 00

			05 01 00 00 78 00 02 11 00
			05 01 00 00 14 00 02 29 00
			//Enable PWM
			29 01 00 00 00 00 02 00 00
			//29 01 00 00 00 00 02 51 ff		
			29 01 00 00 00 00 02 53 24
/*			//Disable sending cmd
			29 01 00 00 00 00 02 00 00
			29 01 00 00 00 00 02 99 00
*/

			];
		qcom,mdss-dsi-off-command = [
			29 01 00 00 00 00 02 00 00
			29 01 00 00 00 00 03 99 95 27
			05 01 00 00 14 00 02 28 00
			05 01 00 00 78 00 02 10 00
			29 01 00 00 00 00 02 00 00
			29 01 00 00 00 00 02 99 00
			29 01 00 00 00 00 02 00 00
			29 01 00 00 00 00 05 F7 5A A5 87 16
			];
		qcom,mdss-dsi-on-command-state = "dsi_lp_mode";
		qcom,mdss-dsi-off-command-state = "dsi_lp_mode";
		qcom,mdss-dsi-h-sync-pulse = <1>;
		qcom,mdss-dsi-traffic-mode = "burst_mode";
		qcom,mdss-dsi-bllp-eof-power-mode;
		qcom,mdss-dsi-bllp-power-mode;
		qcom,esd-check-enabled;
		qcom,mdss-dsi-tx-eot-append;
		//qcom,mdss-dsi-panel-status-check-mode = "bta_check";
		qcom,mdss-dsi-panel-status-command = [06 01 00 01 05 00 01 0A
		                                      06 01 00 01 05 00 01 ac];
		qcom,mdss-dsi-panel-status-command-state = "dsi_lp_mode";
		qcom,mdss-dsi-panel-status-read-length = <1 1>;
		qcom,mdss-dsi-panel-status-check-mode = "reg_read";
		qcom,mdss-dsi-panel-status-value = <0x9c 0x00>;
		qcom,mdss-dsi-lane-0-state;
		qcom,mdss-dsi-lane-1-state;
		qcom,mdss-dsi-lane-2-state;
		qcom,mdss-dsi-lane-3-state;
		qcom,mdss-dsi-panel-timings = [7d 25 1d 00 37 33
			22 27 1e 03 04 00];
		qcom,mdss-dsi-t-clk-post = <0x0d>;
		qcom,mdss-dsi-t-clk-pre = <0x2d>;
		qcom,mdss-dsi-bl-min-level = <2>;
		qcom,mdss-dsi-bl-max-level = <255>;
		qcom,mdss-dsi-dma-trigger = "trigger_sw";
		qcom,mdss-dsi-mdp-trigger = "none";
		qcom,mdss-dsi-bl-pmic-control-type-dcs = "bl_ctrl_dcs";
		qcom,mdss-dsi-bl-pmic-control-type = "bl_ctrl_pwm";
		qcom,mdss-dsi-bl-pmic-pwm-frequency = <100>;
		qcom,mdss-dsi-bl-pmic-bank-select = <0>;
		qcom,mdss-dsi-pwm-gpio = <&pm8953_mpps 4 0>;
		qcom,panel-supply-entries = <&dsi_panel_pwr_supply>;
		qcom,mdss-dsi-reset-sequence = <1 5>, <0 10>, <1 10>;
		qcom,mdss-pan-physical-width-dimension = <65>;
		qcom,mdss-pan-physical-height-dimension = <115>;
	};
};
