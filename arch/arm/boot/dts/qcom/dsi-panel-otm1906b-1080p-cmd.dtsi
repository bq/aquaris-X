/*
 * Copyright (c) 2015, The Linux Foundation. All rights reserved.
 *
 * This program is free software; you can redistribute it and/or modify
 * it under the terms of the GNU General Public License version 2 and
 * only version 2 as published by the Free Software Foundation.
 *
 * This program is distributed in the hope that it will be useful,
 * but WITHOUT ANY WARRANTY; without even the implied warranty of
 * MERCHANTABILITY or FITNESS FOR A PARTICULAR PURPOSE.  See the
 * GNU General Public License for more details.
 */

/*---------------------------------------------------------------------------
 * This file is autogenerated file using gcdb parser. Please do not edit it.
 * Update input XML file to add a new entry or update variable in this file
 * VERSION = "1.0"
 *---------------------------------------------------------------------------*/
&mdss_mdp {
	dsi_otm1906b_1080p_cmd: qcom,mdss_dsi_otm1906b_1080p_cmd {
		qcom,mdss-dsi-panel-name = "otm1906b 1080p cmd mode dsi panel";
		qcom,mdss-dsi-panel-id = <1>;
		qcom,mdss-dsi-panel-type = "dsi_cmd_mode";
		qcom,mdss-dsi-panel-framerate = <62>;
		qcom,mdss-dsi-virtual-channel-id = <0>;
		qcom,mdss-dsi-stream = <0>;
		qcom,mdss-dsi-panel-width = <1080>;
		qcom,mdss-dsi-panel-height = <1920>;
		qcom,mdss-dsi-h-front-porch = <42>;
		qcom,mdss-dsi-h-back-porch = <42>;
		qcom,mdss-dsi-h-pulse-width = <4>;
		qcom,mdss-dsi-h-sync-skew = <0>;
		qcom,mdss-dsi-v-back-porch = <5>;
		qcom,mdss-dsi-v-front-porch = <6>;
		qcom,mdss-dsi-v-pulse-width = <1>;
		qcom,mdss-dsi-h-left-border = <0>;
		qcom,mdss-dsi-h-right-border = <0>;
		qcom,mdss-dsi-v-top-border = <0>;
		qcom,mdss-dsi-v-bottom-border = <0>;
		qcom,mdss-dsi-bpp = <24>;
		qcom,mdss-dsi-underflow-color = <0xff>;
		qcom,mdss-dsi-border-color = <0>;
                qcom,cont-splash-enabled;
		qcom,mdss-dsi-on-command = [
				29 01 00 00 00 00 02 00 00 
				29 01 00 00 00 00 04 FF 19 06 01 
				29 01 00 00 00 00 02 00 80       
				29 01 00 00 00 00 03 FF 19 06    
				29 01 00 00 00 00 02 00 80       
				29 01 00 00 00 00 0F F5 0B 16 0D 16 15 16 15 16 0B 0C 0D 0E 0E 18 
				29 01 00 00 00 00 02 00 E0                                        
				29 01 00 00 00 00 10 F5 0E 16 10 18 11 18 15 14 15 11 16 11 0F 18 00
				29 01 00 00 00 00 02 00 A0                                        
				29 01 00 00 00 00 08 B3 33 04 38 07 80 00 30                      
				29 01 00 00 00 00 02 00 80                                        
				29 01 00 00 00 00 08 C5 00 00 C1 44 21 0F 0F                      
				29 01 00 00 00 00 02 00 90                                        
				29 01 00 00 00 00 0B C5 44 1C 26 00 88 21 32 3B 44 40             
				29 01 00 00 00 00 02 00 A0                                        
				29 01 00 00 00 00 0B C5 44 1B 24 00 88 21 32 3B 44 40             
				29 01 00 00 00 00 02 00 B0                                        
				29 01 00 00 00 00 05 C5 20 20 02 00                               
				29 01 00 00 00 00 02 00 C0                                        
				29 01 00 00 00 00 07 C5 0E 75 60 13 15 15                         
				29 01 00 00 00 00 02 00 00                                        
				29 01 00 00 00 00 03 D8 2B 2B                                     
				29 01 00 00 00 00 02 00 00                                        
				29 01 00 00 00 00 09 D9 00 B2 00 B2 00 B2 00 B2                   
				29 01 00 00 00 00 02 00 80                            
				29 01 00 00 00 00 0F C0 00 73 00 02 06 00 73 02 06 00 73 00 02 06 //modify 7A 57.2 7D 56.5
				//29 01 00 00 00 00 0F C0 00 7D 00 02 06 00 7D 02 06 00 7D 00 02 06 
				29 01 00 00 00 00 02 00 94                                        
				29 01 00 00 00 00 03 C0 00 04                                     
				29 01 00 00 00 00 02 00 A0                                        
				29 01 00 00 00 00 10 C0 00 00 00 05 00 1B 02 00 00 00 00 00 00 00 00
				29 01 00 00 00 00 02 00 D0                                        
				29 01 00 00 00 00 10 C0 00 00 00 04 00 1A 02 00 00 00 00 00 00 00 00
				29 01 00 00 00 00 02 00 80                                        
				29 01 00 00 00 00 03 C1 66 66                                     
				29 01 00 00 00 00 02 00 90                                        
				29 01 00 00 00 00 03 C1 99 00                                     
				29 01 00 00 00 00 02 00 80                                        
				29 01 00 00 00 00 09 C2 82 01 1B 1B 82 01 1B 1B                   
				29 01 00 00 00 00 02 00 A0                                        
				29 01 00 00 00 00 10 C2 00 00 00 00 00 00 00 00 00 00 00 00 00 33 00
				29 01 00 00 00 00 02 00 B0                                        
				29 01 00 00 00 00 10 C2 82 02 00 09 86 81 02 00 09 86 00 00 01 01 01
				29 01 00 00 00 00 02 00 C0                                        
				29 01 00 00 00 00 06 C2 00 02 03 00 00                            
				29 01 00 00 00 00 02 00 D0                                        
				29 01 00 00 00 00 10 C2 82 00 01 02 81 84 02 03 00 01 11 37 00 37 00
				29 01 00 00 00 00 02 00 E0                                        
				29 01 00 00 00 00 0C C2 80 66 00 00 0B 80 66 00 00 0B 23 
				29 01 00 00 00 00 02 00 F0                                        
				29 01 00 00 00 00 10 C2 80 6C 01 00 0A 80 6C 01 00 0A 00 00 0F 00 01
				29 01 00 00 00 00 02 00 80                                        
				29 01 00 00 00 00 0D C3 00 00 00 00 00 00 00 00 00 00 00 00       
				29 01 00 00 00 00 02 00 A0                                        
				29 01 00 00 00 00 09 C3 82 01 1B 1B 82 01 1B 1B                   
				29 01 00 00 00 00 02 00 B0                                        
				29 01 00 00 00 00 0F C3 00 00 00 00 82 02 00 09 86 81 02 00 09 86 
				29 01 00 00 00 00 02 00 C0                                        
				29 01 00 00 00 00 0B C3 00 00 01 01 01 00 02 03 00 00             
				29 01 00 00 00 00 02 00 E0                                        
				29 01 00 00 00 00 10 C3 11 37 00 37 00 80 66 00 00 0B 80 66 00 00 0B
				29 01 00 00 00 00 02 00 F0                                        
				29 01 00 00 00 00 10 C3 23 00 00 80 6C 01 00 0A 80 6C 01 00 0A 00 00
				29 01 00 00 00 00 02 00 80                                        
				29 01 00 00 00 00 03 C4 81 F0                                     
				29 01 00 00 00 00 02 00 80                                        
				29 01 00 00 00 00 0D CB 00 00 00 00 00 00 00 00 00 00 00 00       
				29 01 00 00 00 00 02 00 90                                        
				29 01 00 00 00 00 10 CB 00 00 50 50 00 00 00 00 40 40 00 00 00 00 00
				29 01 00 00 00 00 02 00 A0                                        
				29 01 00 00 00 00 10 CB 00 00 00 BF 00 00 FC FC FC 00 00 33 30 33 30
				29 01 00 00 00 00 02 00 B0                                        
				29 01 00 00 00 00 0D CB 33 30 00 00 00 00 00 00 00 00 00 00       
				29 01 00 00 00 00 02 00 C0                                        
				29 01 00 00 00 00 10 CB 01 01 01 01 01 01 01 01 01 01 01 01 01 01 01
				29 01 00 00 00 00 02 00 D0                                        
				29 01 00 00 00 00 10 CB 01 01 01 FF 01 01 31 31 31 01 00 03 01 03 01
				29 01 00 00 00 00 02 00 E0                                        
				29 01 00 00 00 00 0D CB 03 01 00 01 00 01 00 01 00 00 00 00       
				29 01 00 00 00 00 02 00 F0                                        
				29 01 00 00 00 00 0C CB 00 00 00 00 00 FC 03 33 03 00 00          
				29 01 00 00 00 00 02 00 80                                        
				29 01 00 00 00 00 0D CC 08 09 18 19 0C 0D 0E 0F 14 15 16 17       
				29 01 00 00 00 00 02 00 90                                        
				29 01 00 00 00 00 0D CC 09 08 19 18 0D 0C 12 13 15 14 17 16       
				29 01 00 00 00 00 02 00 A0                                        
				29 01 00 00 00 00 10 CC 14 15 16 17 1C 1D 1E 1F 20 01 02 03 07 07 00
				29 01 00 00 00 00 02 00 B0                                        
				29 01 00 00 00 00 09 CC 01 02 03 04 05 06 07 07                   
				29 01 00 00 00 00 02 00 C0                                        
				29 01 00 00 00 00 10 CC 00 00 00 00 00 00 00 00 15 15 00 00 15 15 00
				29 01 00 00 00 00 02 00 D0                                        
				29 01 00 00 00 00 10 CC 00 00 00 00 00 04 3F 3F 3F 00 00 03 33 03 33
				29 01 00 00 00 00 02 00 E0                                        
				29 01 00 00 00 00 0D CC 03 33 00 00 00 00 00 00 00 00 00 00       
				29 01 00 00 00 00 02 00 80                                        
				29 01 00 00 00 00 10 CD 1A 05 07 1A 08 1A 02 0A 1A 1A 1F 1E 1D 22 21
				29 01 00 00 00 00 02 00 90                                        
				29 01 00 00 00 00 04 CD 20 23 24                                
				29 01 00 00 00 00 02 00 A0                                        
				29 01 00 00 00 00 10 CD 12 06 07 15 08 1A 01 09 1A 1A 1F 1E 1D 22 21
				29 01 00 00 00 00 02 00 B0                                        
				29 01 00 00 00 00 04 CD 20 23 24                                  
				29 01 00 00 00 00 02 00 80                                        
				29 01 00 00 00 00 0F A4 AF 00 64 06 20 40 30 01 62 09 14 1C 00 00 
				29 01 00 00 00 00 02 00 B0                                        
				29 01 00 00 00 00 09 A4 07 49 0E EB 07 49 07 49                   
				29 01 00 00 00 00 02 00 90                                        
				29 01 00 00 00 00 04 A4 00 82 00                                  
				29 01 00 00 00 00 02 00 80                                        
				29 01 00 00 00 00 05 A5 0F 05 1B 01                               
				29 01 00 00 00 00 02 00 81                                        
				29 01 00 00 00 00 03 F3 1F 3F                                     
				29 01 00 00 00 00 02 00 80                                        
				29 01 00 00 00 00 0D A7 40 06 14 03 23 11 01 93 06 0C 00 00       
				29 01 00 00 00 00 02 00 90                                        
				29 01 00 00 00 00 0B A7 00 03 20 23 00 E9 80 E6 07 49             
				29 01 00 00 00 00 02 00 A0                                        
				29 01 00 00 00 00 02 A7 30                                        
				29 01 00 00 00 00 02 00 B0                                        
				29 01 00 00 00 00 06 A7 50 1E 1E 45 00                            
				29 01 00 00 00 00 02 00 C0                                        
				29 01 00 00 00 00 0D A7 20 06 14 03 00 11 01 12 06 0C 00 00       
				29 01 00 00 00 00 02 00 D0                                        
				29 01 00 00 00 00 0B A7 00 03 00 00 01 E0 81 DD 0E FF             
				29 01 00 00 00 00 02 00 E0                                        
				29 01 00 00 00 00 02 A7 30                                        
				29 01 00 00 00 00 02 00 F0                                        
				29 01 00 00 00 00 06 A7 50 3C 3C 3B 00                            
				29 01 00 00 00 00 02 00 80                                        
				29 01 00 00 00 00 0D A9 40 06 14 03 23 11 01 93 06 0C 00 00       
				29 01 00 00 00 00 02 00 90                                        
				29 01 00 00 00 00 0B A9 00 03 20 23 00 E4 80 E1 07 23             
				29 01 00 00 00 00 02 00 A0                                        
				29 01 00 00 00 00 02 A9 30                                        
				29 01 00 00 00 00 02 00 B0                                        
				29 01 00 00 00 00 06 A9 50 1E 1E 45 00                            
				29 01 00 00 00 00 02 00 C0                                        
				29 01 00 00 00 00 0F A9 40 06 14 03 23 11 01 93 06 0C 00 00 80 6E 
				29 01 00 00 00 00 02 00 D0                                        
				29 01 00 00 00 00 0B A9 00 03 20 23 00 E4 80 E1 07 23             
				29 01 00 00 00 00 02 00 E0                                        
				29 01 00 00 00 00 02 A9 30                                        
				29 01 00 00 00 00 02 00 F0                                        
				29 01 00 00 00 00 06 A9 50 1E 1E 45 00                            
				29 01 00 00 00 00 02 00 80                                        
				29 01 00 00 00 00 10 AB 08 55 14 28 00 FF 00 01 0A 20 0A 02 01 03 03
				29 01 00 00 00 00 02 00 A0                                        
				29 01 00 00 00 00 10 AB 00 00 00 18 18 00 00 07 FC 01 01 01 01 00 04
				29 01 00 00 00 00 02 00 B0                                        
				29 01 00 00 00 00 0E AB 03 00 1B 00 14 00 44 04 7F 7F 7F 44 44    
				29 01 00 00 00 00 02 00 80                                        
				29 01 00 00 00 00 08 CE 00 00 00 00 00 00 00                      
				29 01 00 00 00 00 02 00 87                                        
				29 01 00 00 00 00 08 CE 00 00 33 00 33 00 00                      
				29 01 00 00 00 00 02 00 F0                                        
				29 01 00 00 00 00 05 CE 00 00 00 00                               
				29 01 00 00 00 00 02 00 90                                        
				29 01 00 00 00 00 10 CE 00 00 00 00 00 00 00 00 FC 00 FC 00 00 00 00
				29 01 00 00 00 00 02 00 A0                                        
				29 01 00 00 00 00 08 CE 00 00 40 40 40 00 00                      
				29 01 00 00 00 00 02 00 B0                                        
				29 01 00 00 00 00 10 CE 01 01 01 01 01 01 01 01 F1 01 F1 01 01 00 01
				29 01 00 00 00 00 02 00 C0                                        
				29 01 00 00 00 00 08 CE 01 01 01 01 01 01 01                      
				29 01 00 00 00 00 02 00 D0                                        
				29 01 00 00 00 00 10 CE 04 04 04 04 04 04 04 04 F7 04 F7 04 04 00 00
				29 01 00 00 00 00 02 00 E0                                        
				29 01 00 00 00 00 08 CE 00 00 15 15 15 04 04                      
				29 01 00 00 00 00 02 00 E0                                        
				29 01 00 00 00 00 0B B4 1C 19 3F 01 64 5C 01 A0 5F A0             
				29 01 00 00 00 00 02 00 80                                        
				29 01 00 00 00 00 04 A6 00 AB 00                                  
				29 01 00 00 00 00 02 00 90                                        
				29 01 00 00 00 00 09 A6 12 34 57 8A 9B C0 00 00                
				29 01 00 00 00 00 02 00 F0                                     
				29 01 00 00 00 00 02 B4 FF

				29 01 00 00 00 00 02 00 E0
				29 01 00 00 00 00 02 B4 5C
				29 01 00 00 00 00 02 00 80
				29 01 00 00 00 00 03 C1 66 66

				29 01 00 00 00 00 02 00 00 
				29 01 00 00 00 00 19 E1 00 09 11 1e 28 31 41 57 66 7b 89 94 63 5a 51 44 35 27 1d 18 12 09 04 03
				29 01 00 00 00 00 02 00 00 
				29 01 00 00 00 00 19 E2 00 09 11 1e 28 31 41 57 66 7b 89 94 63 5a 51 44 35 27 1d 18 12 09 04 03 
				29 01 00 00 00 00 02 00 00 
				29 01 00 00 00 00 19 E3 00 09 11 1e 28 31 41 57 66 7b 89 94 63 5a 51 44 35 27 1d 18 12 09 04 03
				29 01 00 00 00 00 02 00 00 
				29 01 00 00 00 00 19 E4 00 09 11 1e 28 31 41 57 66 7b 89 94 63 5a 51 44 35 27 1d 18 12 09 04 03
				29 01 00 00 00 00 02 00 00 
				29 01 00 00 00 00 19 E5 00 09 11 1e 28 31 41 57 66 7b 89 94 63 5a 51 44 35 27 1d 18 12 09 04 03
				29 01 00 00 00 00 02 00 00 
				29 01 00 00 00 00 19 E6 00 09 11 1e 28 31 41 57 66 7b 89 94 63 5a 51 44 35 27 1d 18 12 09 04 03
				29 01 00 00 00 00 02 00 00 

				29 01 00 00 00 00 02 00 80                                     
				29 01 00 00 00 00 03 FF 00 00                                  
				29 01 00 00 00 00 02 00 00                                     
				29 01 00 00 00 00 04 FF 00 00 00  
				29 01 00 00 00 00 02 35 00  
				29 01 00 00 00 00 03 44 03 c0 
				05 01 00 00 78 00 01 11
				05 01 00 00 14 00 01 29
				//29 01 00 00 00 00 02 51 ff  
				29 01 00 00 00 00 02 53 24 
		];

		qcom,mdss-dsi-off-command = [05 01 00 00 00 00 02 28 00
					05 01 00 00 78 00 02 10 00];
		qcom,mdss-dsi-on-command-state = "dsi_lp_mode";
		qcom,mdss-dsi-off-command-state = "dsi_hs_mode";
		qcom,mdss-dsi-h-sync-pulse = <0>;
		qcom,mdss-dsi-traffic-mode = "burst_mode";
		qcom,mdss-dsi-bllp-eof-power-mode;
		qcom,mdss-dsi-bllp-power-mode;
		qcom,mdss-dsi-lane-0-state;
		qcom,mdss-dsi-lane-1-state;
		qcom,mdss-dsi-lane-2-state;
		qcom,mdss-dsi-lane-3-state;

		//cmd TE 
		qcom,mdss-dsi-te-pin-select = <1>;
		qcom,mdss-dsi-te-dcs-command = <1>;
		qcom,mdss-dsi-te-check-enable;
		qcom,mdss-dsi-te-using-te-pin;
		qcom,mdss-dsi-tx-eot-append;

		//add lcd esd
		qcom,esd-check-enabled;
		qcom,mdss-dsi-panel-status-command = [06 01 00 01 05 00 01 0A
		                                      06 01 00 01 05 00 01 ac];
		qcom,mdss-dsi-panel-status-command-state = "dsi_lp_mode";
		qcom,mdss-dsi-panel-status-read-length = <1 1>;
		qcom,mdss-dsi-panel-status-check-mode = "reg_read";
		qcom,mdss-dsi-panel-status-value = <0x9c 0x00>;
		//esd end

		qcom,mdss-dsi-panel-timings = [DB 34 22 00 64 66 28 38 2B 03 04];
		qcom,mdss-dsi-t-clk-post = <0x03>;
		qcom,mdss-dsi-t-clk-pre = <0x29>;
		qcom,mdss-dsi-bl-pmic-control-type-dcs = "bl_ctrl_dcs";
		qcom,mdss-dsi-bl-pmic-control-type = "bl_ctrl_pwm";
		qcom,mdss-dsi-bl-pmic-pwm-frequency = <100>;
		qcom,mdss-dsi-bl-pmic-bank-select = <0>;
		qcom,mdss-dsi-pwm-gpio = <&pm8953_mpps 4 0>;
		qcom,panel-supply-entries = <&dsi_panel_pwr_supply>;
		qcom,mdss-dsi-dma-trigger = "trigger_sw";
		qcom,mdss-dsi-mdp-trigger = "none";
		qcom,mdss-dsi-bl-min-level = <2>;
		qcom,mdss-dsi-bl-max-level = <255>;
		qcom,mdss-dsi-reset-sequence = <1 20>, <0 10>, <1 80>;
		qcom,mdss-pan-physical-width-dimension = <65>;
		qcom,mdss-pan-physical-height-dimension = <115>;
	};
};
