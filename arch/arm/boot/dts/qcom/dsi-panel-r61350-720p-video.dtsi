/* Copyright (c) 2015, The Linux Foundation. All rights reserved.
 *
 * This program is free software; you can redistribute it and/or modify
 * it under the terms of the GNU General Public License version 2 and
 * only version 2 as published by the Free Software Foundation.
 *
 * This program is distributed in the hope that it will be useful,
 * but WITHOUT ANY WARRANTY; without even the implied warranty of
 * MERCHANTABILITY or FITNESS FOR A PARTICULAR PURPOSE.  See the
 * GNU General Public License for more details.
 */

&mdss_mdp {
	dsi_r61350_720p_vid: qcom,mdss_dsi_r61350_720p_video {
		qcom,mdss-dsi-panel-name = "truly R61350 720p video mode dsi panel";
		qcom,mdss-dsi-panel-controller = <&mdss_dsi0>;
		qcom,mdss-dsi-panel-type = "dsi_video_mode";
		qcom,mdss-dsi-panel-destination = "display_1";
		qcom,cont-splash-enabled;
		qcom,mdss-dsi-panel-framerate = <60>;
		qcom,mdss-dsi-virtual-channel-id = <0>;
		qcom,mdss-dsi-stream = <0>;
		qcom,mdss-dsi-panel-width = <720>;
		qcom,mdss-dsi-panel-height = <1280>;
		qcom,mdss-dsi-h-front-porch = <84>;
		qcom,mdss-dsi-h-back-porch = <56>;
		qcom,mdss-dsi-h-pulse-width = <20>;
		qcom,mdss-dsi-h-sync-skew = <0>;
		qcom,mdss-dsi-v-front-porch = <24>;
		qcom,mdss-dsi-v-back-porch = <20>;
		qcom,mdss-dsi-v-pulse-width = <4>;
		qcom,mdss-dsi-h-left-border = <0>;
		qcom,mdss-dsi-h-right-border = <0>;
		qcom,mdss-dsi-v-top-border = <0>;
		qcom,mdss-dsi-v-bottom-border = <0>;
		qcom,mdss-dsi-bpp = <24>;
		qcom,mdss-dsi-color-order = "rgb_swap_rgb";
		qcom,mdss-dsi-underflow-color = <0xff>;
		qcom,mdss-dsi-border-color = <0>;
		qcom,mdss-pan-physical-width-dimension = <65>;
		qcom,mdss-pan-physical-height-dimension = <115>;
		qcom,mdss-dsi-on-command = [
			23 01 00 00 00 00 02 B0 00
			29 01 00 00 00 00 02 E3 01 
			29 01 00 00 00 00 03 B6 41 2C
			29 01 00 00 00 00 07 C0 23 B2 10 10 02 7F 
			29 01 00 00 00 00 17 C1 0B 8A A0 8A 00 00 00 00 7F 03 08 08 08 08 08 08 08 08 08 08 08 08
			29 01 00 00 00 00 02 C3 75                                                             
			29 01 00 00 00 00 1D C5 06 06 43 43 00 00 03 01 03 03 00 00 00 00 00 00 00 0A 00 00 00 00 00 00 00 00 00 0E
			29 01 00 00 00 00 03 C6 01 02                                                                            
			29 01 00 00 00 00 3B C8 09 13 11 1D 1D 26 22 24 20 00 00 00 00 00 00 01 00 00 00 00 00 00 0A 13 11 1D 1D 27 23 25 21 00 00 00 00 00 00 02 00 00 00 00 00 00 89 00 00 00 01 00 00 00 02 00 00 00 03 00
			29 01 00 00 00 00 27 CA 1B 2B 36 43 4F 59 6E 7E 8C 94 47 53 62 75 81 8D 9C AA BE 1B 2B 36 43 4F 59 6E 7F 8C 98 49 57 66 79 81 8D 9C AA BE
			29 01 00 00 00 00 07 D0 02 5E 5F 00 2C 95
			29 01 00 00 00 00 02 D1 03    
			29 01 00 00 00 00 03 D2 8E 0B
			29 01 00 00 00 00 02 E5 02 
			29 01 00 00 00 00 03 D5 28 28
			05 01 00 00 78 00 02 11 00
			05 01 00 00 32 00 02 29 00
			];
		qcom,mdss-dsi-off-command = [
			05 01 00 00 14 00 02 28 00 //display off and delay 20ms
			05 01 00 00 82 00 02 10 00 //sleep in and delay 130ms
			29 01 00 00 0a 00 02 B0 00
			29 01 00 00 14 00 02 B1 01 //deep stanby and delay 20ms
			];
		qcom,mdss-dsi-on-command-state = "dsi_lp_mode";
		qcom,mdss-dsi-off-command-state = "dsi_lp_mode";
		qcom,mdss-dsi-h-sync-pulse = <0>;
		qcom,mdss-dsi-traffic-mode = "non_burst_sync_pulse";
		qcom,mdss-dsi-lane-map = "lane_map_0123";
		qcom,mdss-dsi-bllp-eof-power-mode;
		qcom,mdss-dsi-bllp-power-mode;
		qcom,mdss-dsi-lane-0-state;
		qcom,mdss-dsi-lane-1-state;
		qcom,mdss-dsi-lane-2-state;
		qcom,mdss-dsi-lane-3-state;
		qcom,mdss-dsi-panel-timings = [7B 1A 10 00 3E 40 16 1E 15 03 04 00];
		qcom,mdss-dsi-t-clk-post = <0x04>;
		qcom,mdss-dsi-t-clk-pre = <0x19>;
		qcom,mdss-dsi-bl-min-level = <1>;
		qcom,mdss-dsi-bl-max-level = <4095>;
		qcom,mdss-dsi-dma-trigger = "trigger_sw";
		qcom,mdss-dsi-mdp-trigger = "none";
		qcom,mdss-dsi-bl-pmic-control-type = "bl_ctrl_pwm";
		qcom,mdss-dsi-bl-pmic-pwm-frequency = <50>;
		qcom,mdss-dsi-bl-pmic-bank-select = <0>;
		qcom,mdss-dsi-pwm-gpio = <&pm8937_mpps 4 0>;
		qcom,mdss-dsi-reset-sequence = <1 20>, <0 10>, <1 20>;
                qcom,mdss-dsi-lp11-init;
		qcom,panel-supply-entries = <&dsi_panel_pwr_supply>;
		//add lcd esd
		qcom,mdss-dsi-panel-status-command = [06 01 00 01 05 00 02 0A 08];
		qcom,mdss-dsi-panel-status-command-state = "dsi_hs_mode";
		qcom,mdss-dsi-panel-status-check-mode = "reg_read";
		qcom,mdss-dsi-panel-status-value = <0x9c>;
		qcom,esd-check-enabled;
		//esd end
	};
};
